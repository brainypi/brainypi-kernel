/dts-v1/;
/plugin/;

/ {
	model = "BRAINYPI";
	compatible = "rockchip,brainypi","rockchip,rk3399";

	fragment@0 {
		target = <&i2c2>;

		__overlay__ {
			#address-cells = <1>;
			#size-cells = <0>;

			at24c02@50 {
				status = "okay";
				compatible = "atmel,24c02";
				reg = <0x50>;
				pagesize = <8>;
			};
		};
	};
};
