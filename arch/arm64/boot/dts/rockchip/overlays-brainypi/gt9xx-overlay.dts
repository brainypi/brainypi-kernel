/dts-v1/;
/plugin/;

/ {
	model = "BRAINYPI";
	compatible = "rockchip,brainypi","rockchip,rk3399";

	fragment@0 {
		target = <&i2c1>;

		__overlay__ {
			gt9xx: gt9xx@14 {
				x2y;
				status = "okay";
			};
		};
	};
};
